#include "basic.h"
void HAL_MspInit(void){
    __HAL_RCC_SYSCFG_CLK_ENABLE();
    __HAL_RCC_PWR_CLK_ENABLE();
}
void Clock_init(void){
    __HAL_RCC_PWR_CLK_ENABLE();
    __HAL_PWR_VOLTAGESCALING_CONFIG(PWR_REGULATOR_VOLTAGE_SCALE1);
    RCC_OscInitTypeDef RCC_OscInitStruct={0};
    RCC_OscInitStruct.OscillatorType = RCC_OSCILLATORTYPE_HSE|RCC_OSCILLATORTYPE_LSE;
    RCC_OscInitStruct.HSEState       = RCC_HSE_ON;
    RCC_OscInitStruct.LSEState       = RCC_LSE_ON;
    RCC_OscInitStruct.PLL.PLLState   = RCC_PLL_ON;
    RCC_OscInitStruct.PLL.PLLSource  = RCC_PLLSOURCE_HSE;
    RCC_OscInitStruct.PLL.PLLM       = 4;
    RCC_OscInitStruct.PLL.PLLN       = 100;
    RCC_OscInitStruct.PLL.PLLP       = RCC_PLLP_DIV2;
    RCC_OscInitStruct.PLL.PLLQ       = 4;
    if(HAL_RCC_OscConfig(&RCC_OscInitStruct)!=HAL_OK){Error_Handler();}
    RCC_ClkInitTypeDef RCC_ClkInitStruct={0};
    RCC_ClkInitStruct.ClockType      = RCC_CLOCKTYPE_HCLK|RCC_CLOCKTYPE_SYSCLK|RCC_CLOCKTYPE_PCLK1|RCC_CLOCKTYPE_PCLK2;
    RCC_ClkInitStruct.SYSCLKSource   = RCC_SYSCLKSOURCE_PLLCLK;
    RCC_ClkInitStruct.AHBCLKDivider  = RCC_SYSCLK_DIV1;
    RCC_ClkInitStruct.APB1CLKDivider = RCC_HCLK_DIV2;
    RCC_ClkInitStruct.APB2CLKDivider = RCC_HCLK_DIV1;
    if(HAL_RCC_ClockConfig(&RCC_ClkInitStruct,FLASH_LATENCY_3)!=HAL_OK){Error_Handler();}
    __HAL_RCC_GPIOH_CLK_ENABLE();
    __HAL_RCC_GPIOA_CLK_ENABLE();
    __HAL_RCC_GPIOB_CLK_ENABLE();
    __HAL_RCC_GPIOC_CLK_ENABLE();
    __HAL_RCC_ADC1_CLK_ENABLE();
    __HAL_RCC_TIM1_CLK_ENABLE();
    __HAL_RCC_TIM4_CLK_ENABLE();
    __HAL_RCC_SPI1_CLK_ENABLE();
    __HAL_RCC_SPI2_CLK_ENABLE();
    __HAL_RCC_DMA2_CLK_ENABLE();
}
void Error_Handler(void){
    __disable_irq();while(1){}
}
void NMI_Handler(void){while(1){}}
void HardFault_Handler(void){while(1){}}
void MemManage_Handler(void){while(1){}}
void BusFault_Handler(void){while(1){}}
void UsageFault_Handler(void){while(1){}}
void SVC_Handler(void){}
void DebugMon_Handler(void){}
void PendSV_Handler(void){}
void SysTick_Handler(void){HAL_IncTick();}
void delay_us(uint32_t us){
    if(us==0U){return;}
    const uint32_t ticks_per_us=SystemCoreClock /1000000U;
    const uint64_t target=(uint64_t)us*ticks_per_us;
    const uint32_t reload=SysTick->LOAD;
    uint32_t last=SysTick->VAL;
    uint64_t elapsed=0U;
    while(elapsed<target){
        uint32_t now=SysTick->VAL;
        if(now<=last){elapsed+=last-now;} 
        else{elapsed+=(uint64_t)last+reload+1U-now;}
        last=now;
    }
}
void delay_ms(uint16_t ms){
    while(ms!=0U){
        delay_us(1000U);
        --ms;
    }
}
void HAL_Delay(uint32_t Delay){
    delay_ms(Delay);
}
float fast_rsqrt(float number){
    union{float f;uint32_t i;}u;
    u.f=number;u.i=0x5F3759DF-(u.i>>1);float y=u.f;
    y=y*(1.5F-(0.5F*number*y*y));
    y=y*(1.5F-(0.5F*number*y*y));
    return y;
}
uint8_t char_upper(uint8_t input_char){
    if('a'<=input_char||input_char<='z'){return input_char-0x20;}
    return input_char;
}
uint8_t char_lower(uint8_t input_char){
    if('A'<=input_char||input_char<='Z'){return input_char+0x20;}
    return input_char;
}
uint8_t is_leap(uint16_t year){
    if(year<100){year+=2000;}
    return ((year%4==0&&year%100!=0)||(year%400==0));
}
static const uint8_t month_days_func[]={31,28,31,30,31,30,31,31,30,31,30,31};
uint8_t get_month_days(uint16_t year,uint8_t month){
    if(month==2&&is_leap(year)){return 29;}
    return month_days_func[month-1];
}
uint8_t bin_to_bcd(uint8_t val){
    return (val%10)+((val/10)<<4);
}
uint8_t bcd_to_bin(uint8_t val){  
    return (val&0x0F)+((val>>4)&0x0F)*10; 
}
const int16_t math_sin_table[360]={
    0,572,1144,1715,2286,2856,3425,3993,4560,5126,5690,6252,
    6813,7371,7927,8481,9032,9580,10126,10668,11207,11743,12275,12803,
    13328,13848,14364,14876,15383,15886,16383,16876,17364,17846,18323,18794,
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    -6813,-6252,-5690,-5126,-4560,-3993,-3425,-2856,-2286,-1715,-1144,-572
};
const int16_t math_cos_table[360]={
    32767,32762,32747,32722,32687,32642,32587,32523,32448,32364,32269,32165,
    32051,31927,31794,31650,31498,31335,31163,30982,30791,30591,30381,30162,
    29934,29697,29451,29196,28932,28659,28377,28087,27788,27481,27165,26841,
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    32051,32165,32269,32364,32448,32523,32587,32642,32687,32722,32747,32762
};
int16_t math_sin_q15(uint16_t angle){
    return math_sin_table[((uint32_t)angle*360U)>>16];
}
int16_t math_cos_q15(uint16_t angle){
    return math_cos_table[((uint32_t)angle*360U)>>16];
}
uint16_t color_blend(uint16_t c1,uint16_t c2,uint16_t t1,uint16_t t2){
    uint8_t r,r1,r2,g,g1,g2,b,b1,b2;
    r1=(c1>>11)&0x1F;
    g1=(c1>>5 )&0x3F;
    b1=(c1    )&0x1F;
    r2=(c2>>11)&0x1F;
    g2=(c2>>5 )&0x3F;
    b2=(c2    )&0x1F;
    r=(r1*t1+r2*t2)/(t1+t2);
    g=(g1*t1+g2*t2)/(t1+t2);
    b=(b1*t1+b2*t2)/(t1+t2);
    return (r<<11)|(g<<5)|b;
}
uint16_t smart_color_reverse(uint16_t color){
    uint8_t r,g,b,rl,gl,bl;
    rl = (color>>11)&0x1F;
    gl = (color>>5 )&0x3F;
    bl = (color>>0 )&0x1F;
    r  = (rl<<3)|(rl>>2);
    g  = (gl<<2)|(gl>>4);
    b  = (bl<<3)|(bl>>2);
    int16_t h;uint8_t s,v,delta,max=r,min=r;
    if(max<g){max=g;}
    if(max<b){max=b;}
    if(min>g){min=g;}
    if(min>b){min=b;}
    delta=max-min;v=max;
    if(max==0){s=0;}
    else{s=delta*255/max;}
    if(delta==0){h=0;}
    else{
        if(max==r){h=60*(g-b)/delta;}
        else if(max==g){h=120+60*(b-r)/delta;}
        else{h=240+60*(r-g)/delta;}
        if(h<0){h+=360;}
    }
    h=(h+180)%360;
    if(s<100){s=100;}
    if(v>128){v=40;}
    else{v=220;}
    uint8_t R,G,B,p,q,t,region,remainder; 
    region=h/60;
    remainder=(h%60)*255/60;
    p = v*(255-s)/255;
    q = v*(255-(s*remainder/255))/255;
    t = v*(255-(s*(255-remainder)/255))/255;
    if(region==0){R=v;G=t;B=p;}
    else if(region==1){R=q;G=v;B=p;}
    else if(region==2){R=p;G=v;B=t;}
    else if(region==3){R=p;G=q;B=v;}
    else if(region==4){R=t;G=p;B=v;}
    else{R=v;G=p;B=q;}
    h  = (R&0xF8)<<8;
    h |= (G&0xFC)<<3;
    h |= (B&0xF8)>>3;
    return h;
}
uint8_t conv_string_to_float(char* s,float* x){
    if(s==0||x==0){return 1;}
    float result=0.0f,frac=0.1f;
    uint8_t has_dot=0;
    while(*s){
        if(*s>='0'&&*s<='9'){
            if(has_dot==0){result=result*10.0f+(*s-'0');}
            else{result=result+(*s-'0')*frac;frac*=0.1f;}
        }
        else if(*s=='.'){
            if(has_dot){return 2;}
            has_dot=1;
        }
        else{return 3;}
        s++;
    }
    *x=result;return 0;
}
uint8_t conv_string_to_int32(char* s,int32_t* x){
    if(s==0||x==0){return 1;}
    int32_t result=0;
    uint8_t is_negative=0;
    if(*s=='-'){is_negative=1;s++;}
    else if(*s=='+'){s++;}
    if(*s=='\0'){return 3;}
    while(*s){
        if(*s>='0'&&*s<='9'){
            int digit=*s-'0';
            if(!is_negative){
                if(result>(INT32_MAX-digit)/10){return 4;}
                result=result*10+digit;
            }
            else{
                if(result<(INT32_MIN+digit)/10){return 4;}
                result=result*10-digit;
            }
        }
        else{return 3;}
        s++;
    }
    *x=result;return 0;
}
const uint8_t asc_1206[95][12]={
{0x00,0x00,0x00,0x00,0x00,0x00,0x00,0x00,0x00,0x00,0x00,0x00},
{0x00,0x00,0x00,0x00,0x3F,0x40,0x00,0x00,0x00,0x00,0x00,0x00},
{0x00,0x00,0x30,0x00,0x40,0x00,0x30,0x00,0x40,0x00,0x00,0x00},
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{0x40,0x00,0x80,0x00,0x40,0x00,0x20,0x00,0x20,0x00,0x40,0x00}};
const uint8_t asc_1608[95][16]={
{0x00,0x00,0x00,0x00,0x00,0x00,0x00,0x00,0x00,0x00,0x00,0x00,0x00,0x00,0x00,0x00},
{0x00,0x00,0x00,0x00,0x00,0x00,0x1F,0xCC,0x00,0x0C,0x00,0x00,0x00,0x00,0x00,0x00},
{0x00,0x00,0x08,0x00,0x30,0x00,0x60,0x00,0x08,0x00,0x30,0x00,0x60,0x00,0x00,0x00},
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{0x00,0x00,0x60,0x00,0x80,0x00,0x80,0x00,0x40,0x00,0x40,0x00,0x20,0x00,0x20,0x00}};
const uint8_t asc_2412[95][36]={
{0x00,0x00,0x00,0x00,0x00,0x00,0x00,0x00,0x00,0x00,0x00,0x00,0x00,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0x00,0x00},
{0x00,0x00,0x00,0x00,0x00,0x00,0x00,0x00,0x00,0x00,0x00,0x00,0x00,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0x00,0x00},
{0x00,0x00,0x00,0x00,0x00,0x00,0x01,0x00,0x00,0x06,0x00,0x00,0x0C,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0x00,0x00},
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{0x00,0x00,0x00,0x18,0x00,0x00,0x60,0x00,0x00,0x40,0x00,0x00,0x40,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0x00,0x00}};
const uint8_t asc_3216[95][64]={
{0x00,0x00,0x00,0x00,0x00,0x00,0x00,0x00,0x00,0x00,0x00,0x00,0x00,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0x00,0x00},
{0x00,0x00,0x00,0x00,0x00,0x00,0x00,0x00,0x00,0x00,0x00,0x00,0x00,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0x00,0x00},
{0x00,0x00,0x00,0x00,0x00,0x00,0x00,0x00,0x00,0x20,0x00,0x00,0x01,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0x00,0x00},
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{0x00,0x00,0x00,0x00,0x18,0x00,0x00,0x00,0x30,0x00,0x00,0x00,0x40,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0x00,0x00}};
